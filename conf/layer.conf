## conf/layer.conf
```bitbake
# We have a conf and classes directory, add to BBPATH
BBPATH =. "${LAYERDIR}:"

# We have recipes-* directories, add to BBFILES
BBFILES += "${LAYERDIR}/recipes-*/*/*.bb \
            ${LAYERDIR}/recipes-*/*/*.bbappend"

BBFILE_COLLECTIONS += "centos"
BBFILE_PATTERN_centos = "^${LAYERDIR}/"
BBFILE_PRIORITY_centos = "30"
LAYERVERSION_centos = "11"
LAYERSERIES_COMPAT_centos = "dunfell"
```
